## components/config/Kconfig.projbuild
```kconfig
menu "KneeExo Application"

    choice KNEEEXO_APP_PROFILE
        prompt "App profile (which firmware to build)"
        default KNEEEXO_APP_PROFILE_NORMAL
        help
            选择当次构建烧入哪一个 demo / 主程序。
            后续每次 idf.py menuconfig 切到不同 profile，再 build flash 即可。

        config KNEEEXO_APP_PROFILE_NORMAL
            bool "normal: IMU + RS02 motor + 100Hz control loop"
            help
                实验主程序：初始化 IMU + CAN，用户零位采样后自动使能电机并启动控制。
                当前状态阻抗和重力补偿独立于 wear 子模式；transparent 不保证零力矩。
                上电后会自动使能，请先离体台架验证，参见 docs/project-status.md。

        config KNEEEXO_APP_PROFILE_TWAI_LOOPBACK
            bool "twai_loopback: TWAI 自环自检 (最安全, 不接电机)"
            help
                ESP32 TWAI 控制器自发自收 50 帧。不需要接收发器或电机也能通过。
                用来确认 CAN 控制器、波特率、引脚配置正确。

        config KNEEEXO_APP_PROFILE_IMU_ONLY
            bool "imu_only: 只跑 IMU + CSV over USB-CDC (PC 实时绘图)"
            help
                仅初始化 IMU1 (UART1)，按设定频率把 acc/gyro/euler 流式打到主串口。
                每行以 $IMU, 开头，配套 tools/imu_plot.py 在 PC 端实时画图。

        config KNEEEXO_APP_PROFILE_MOTOR_TEST
            bool "motor_test: 电机使能 + 反馈 + 方向标定 (慎用)"
            help
                只接 CAN + 电机供电，不依赖 IMU。
                默认只读反馈、不使能；勾选 KNEEEXO_PROFILE_MOTOR_TEST_AUTOSPIN 后才会
                上电使能 + 给 ±0.1 rad 小幅摆动来标定方向。
    endchoice

    config KNEEEXO_PROFILE_MOTOR_TEST_AUTOSPIN
        bool "motor_test: 上电后自动给 ±0.1 rad 小幅摆动 (用于标定方向)"
        depends on KNEEEXO_APP_PROFILE_MOTOR_TEST
        default n
        help
            建议第一次只读反馈、确认接线 OK，再开此项让电机轻轻动一下，
            观察电机正向旋转对应屈膝还是伸膝，回头改 config.h 的 JOINT_DIR_SIGN。

    config KNEEEXO_PROFILE_MOTOR_LIMIT_CALIB
        bool "motor_test: 悬空自动寻找机械限位 (危险, 仅离体)"
        depends on KNEEEXO_APP_PROFILE_MOTOR_TEST
        default n
        help
            仅在电机/膝关节机构悬空且无人穿戴时使用。电机会低速向两个方向
            搜索机械限位，根据力矩升高 + 速度停滞 + 位置变化很小判断碰到限位，
            最后打印建议写入 config.h 的零位/限位参数。

    config KNEEEXO_LIMIT_CALIB_TORQUE_X100
        int "limit_calib: 碰限位力矩阈值 (Nm x100)"
        default 80
        range 20 600
        depends on KNEEEXO_PROFILE_MOTOR_LIMIT_CALIB
        help
            实际阈值 = 该数值 / 100。默认 0.80 Nm。若机构自重/摩擦较大，
            可以适当增大；若限位较脆弱，应减小。

    config KNEEEXO_LIMIT_CALIB_SPEED_MRAD_S
        int "limit_calib: 搜索速度 (mrad/s)"
        default 120
        range 20 500
        depends on KNEEEXO_PROFILE_MOTOR_LIMIT_CALIB
        help
            位置命令爬坡速度。默认 120 mrad/s = 0.12 rad/s，较慢。

    config KNEEEXO_LIMIT_CALIB_MAX_TRAVEL_MRAD
        int "limit_calib: 单方向最大搜索行程 (mrad)"
        default 2500
        range 200 8000
        depends on KNEEEXO_PROFILE_MOTOR_LIMIT_CALIB
        help
            从起点出发单方向最多搜索多少机械弧度。默认 2.5 rad，防止方向错
            或限位未安装时一直转。

    config KNEEEXO_LIMIT_CALIB_HOLD_MS
        int "limit_calib: 碰限位条件持续时间 (ms)"
        default 200
        range 100 1500
        depends on KNEEEXO_PROFILE_MOTOR_LIMIT_CALIB

    config KNEEEXO_IMU_CSV_HZ
        int "imu_only profile: CSV output rate (Hz)"
        default 100
        range 10 500
        depends on KNEEEXO_APP_PROFILE_IMU_ONLY

    config KNEEEXO_CONTROL_HZ
        int "Control loop frequency (Hz)"
        default 100
        range 50 1000
        help
            control_task 主循环频率。默认 100Hz（10ms 周期）。

    choice KNEEEXO_WEAR_CONTROL_MODE
        prompt "Wear control mode"
        depends on KNEEEXO_APP_PROFILE_NORMAL
        default KNEEEXO_WEAR_MODE_TRANSPARENT
        help
            选择叠加在状态阻抗和重力补偿上的速度项。
            transparent 只是不叠加速度项，当前不保证零力矩；先离体验证。

        config KNEEEXO_WEAR_MODE_TRANSPARENT
            bool "transparent: no extra velocity term (FSM/gravity still active)"

        config KNEEEXO_WEAR_MODE_DAMPING
            bool "damping: resist joint velocity with small torque"

        config KNEEEXO_WEAR_MODE_ASSIST
            bool "assist: small velocity-follow assist + landing buffer"
    endchoice

    config KNEEEXO_USER_ZERO_CALIB_MS
        int "wear: user zero calibration duration (ms)"
        default 3000
        range 0 10000
        depends on KNEEEXO_APP_PROFILE_NORMAL
        help
            normal/wear profile 启动后，在电机使能前读取电机位置并平均。
            穿戴者保持自然伸膝，该平均值作为本次穿戴 user zero。
            0 表示跳过运行时用户零位标定。

    config KNEEEXO_DAMPING_B_X100
        int "damping: viscous damping coefficient (Nm/(rad/s) x100)"
        default 30
        range 0 300
        depends on KNEEEXO_WEAR_MODE_DAMPING
        help
            阻尼力矩 tau = -B * joint_velocity。默认 0.30 Nm/(rad/s)。
            第一次穿戴建议保持较小，确认不顶腿后再增大。

    config KNEEEXO_DAMPING_MAX_TORQUE_X100
        int "damping: torque clamp (Nm x100)"
        default 80
        range 10 300
        depends on KNEEEXO_WEAR_MODE_DAMPING
        help
            阻尼模式最大输出力矩幅值。默认 0.80 Nm。

    config KNEEEXO_ASSIST_FOLLOW_B_X100
        int "assist: velocity-follow gain (Nm/(rad/s) x100)"
        default 10
        range 0 150
        depends on KNEEEXO_WEAR_MODE_ASSIST
        help
            顺势助力 tau = +B * joint_velocity，属于负阻尼，必须很小。
            默认 0.10 Nm/(rad/s)，只是让你感觉更轻一点，不用于正式助力。

    config KNEEEXO_ASSIST_MAX_TORQUE_X100
        int "assist: velocity-follow torque clamp (Nm x100)"
        default 35
        range 10 200
        depends on KNEEEXO_WEAR_MODE_ASSIST

    config KNEEEXO_ASSIST_VEL_DEADBAND_MRAD_S
        int "assist: velocity deadband (mrad/s)"
        default 120
        range 0 1000
        depends on KNEEEXO_WEAR_MODE_ASSIST
        help
            速度小于该阈值时不助力，避免站立时轻微抖动被放大。

    config KNEEEXO_LANDING_BUFFER_B_X100
        int "assist: landing buffer damping (Nm/(rad/s) x100)"
        default 80
        range 0 400
        depends on KNEEEXO_WEAR_MODE_ASSIST
        help
            接近伸膝端且检测到膝盖快速屈曲时，施加反向阻尼作为落地缓冲。

    config KNEEEXO_LANDING_BUFFER_MAX_TORQUE_X100
        int "assist: landing buffer torque clamp (Nm x100)"
        default 80
        range 10 400
        depends on KNEEEXO_WEAR_MODE_ASSIST

    config KNEEEXO_LANDING_BUFFER_NEAR_EXT_MRAD
        int "assist: landing buffer near-extension window (mrad)"
        default 450
        range 50 1500
        depends on KNEEEXO_WEAR_MODE_ASSIST

    config KNEEEXO_LANDING_BUFFER_MIN_FLEX_VEL_MRAD_S
        int "assist: landing buffer minimum flexion velocity (mrad/s)"
        default 350
        range 50 3000
        depends on KNEEEXO_WEAR_MODE_ASSIST

    config KNEEEXO_GAIT_IMU_ENABLE
        bool "legacy gait flag (current normal FSM runs independently)"
        depends on KNEEEXO_APP_PROFILE_NORMAL
        default n
        help
            保留旧 profile 别名兼容性。当前 control_task 始终使用 IMU2 更新 FSM，
            此开关不控制 FSM 或状态阻抗的执行。

    config KNEEEXO_GAIT_IMPACT_SPIKE_X100
        int "gait: landing impact spike threshold (g x100)"
        default 8
        range 5 300
        depends on KNEEEXO_GAIT_IMU_ENABLE
        help
            acc_norm 的高通尖刺阈值。Kconfig 默认 0.08g；脚本或 NVS 可能覆盖。

    config KNEEEXO_GAIT_LANDING_COOLDOWN_MS
        int "gait: landing event cooldown (ms)"
        default 350
        range 50 1500
        depends on KNEEEXO_GAIT_IMU_ENABLE

    config KNEEEXO_GAIT_SWING_RATE_DPS
        int "gait: thigh pitch rate threshold for swing (deg/s)"
        default 35
        range 5 200
        depends on KNEEEXO_GAIT_IMU_ENABLE

    config KNEEEXO_DEFAULT_KP
        int "Default motion-mode Kp (x100)"
        default 500
        range 0 50000
        help
            运控模式默认 Kp，实际值 = 该数值 / 100。0 ~ 500。

    config KNEEEXO_DEFAULT_KD
        int "Default motion-mode Kd (x100)"
        default 100
        range 0 500
        help
            运控模式默认 Kd，实际值 = 该数值 / 100。0 ~ 5。

endmenu
```

## sdkconfig.defaults
```kconfig
# ---- Target ---------------------------------------------------------------
CONFIG_IDF_TARGET="esp32s3"

# ---- Flash / PSRAM (ESP32-S3-N16R8 = 16MB Flash / 8MB Octal PSRAM) ---------
CONFIG_ESPTOOLPY_FLASHSIZE_16MB=y
CONFIG_ESPTOOLPY_FLASHSIZE="16MB"
CONFIG_SPIRAM=y
CONFIG_SPIRAM_MODE_OCT=y
CONFIG_SPIRAM_SPEED_80M=y
CONFIG_SPIRAM_USE_MALLOC=y

# ---- Partitions -----------------------------------------------------------
CONFIG_PARTITION_TABLE_CUSTOM=y
CONFIG_PARTITION_TABLE_CUSTOM_FILENAME="partitions.csv"
CONFIG_PARTITION_TABLE_FILENAME="partitions.csv"

# ---- FreeRTOS -------------------------------------------------------------
# 1kHz tick 方便 10ms 控制周期与 vTaskDelayUntil
CONFIG_FREERTOS_HZ=1000
CONFIG_FREERTOS_UNICORE=n

# ---- Main task ------------------------------------------------------------
CONFIG_ESP_MAIN_TASK_STACK_SIZE=8192

# ---- C++ ------------------------------------------------------------------
CONFIG_COMPILER_CXX_EXCEPTIONS=n
CONFIG_COMPILER_CXX_RTTI=n

# ---- Log ------------------------------------------------------------------
CONFIG_LOG_DEFAULT_LEVEL_INFO=y
CONFIG_LOG_MAXIMUM_LEVEL_DEBUG=y
CONFIG_LOG_COLORS=y

# ---- Watchdog -------------------------------------------------------------
# 打开 Task WDT，但允许闲时 idle
CONFIG_ESP_TASK_WDT_INIT=y
CONFIG_ESP_TASK_WDT_TIMEOUT_S=5
```
